## config/boards/shields/ziptie/Kconfig.defconfig
```kconfig
if SHIELD_ZIPTIE

config ZMK_KEYBOARD_NAME
    default "Ziptie"

config USB_DEVICE_PRODUCT
    default ZMK_KEYBOARD_NAME

config ZMK_USB
    bool "USB"
    select USB

endif
```
